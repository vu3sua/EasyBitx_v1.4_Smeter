/*************************************************************************************************************************************************************************
  Easy Bitx HF Mono Band Rigs(80m, 40m, 20m) VFO / BFO sketch with Si5351 and Arduino Nano with 10Mhz IF.
  Hardware VU3SUA VFO/BFO Board with 16X2 LCD
  Nitin William - VU3GAO September/2021 - Version 1.4
  Code derived from J. CesarSound - ver 1.0 - Dec/2020.
  https://groups.io/g/BITX20/topic/bitx_40_dds_vfo/4104090?p=
 *************************************************************************************************************************************************************************/

//Libraries
#include <Wire.h>                 //IDE Standard
#include <Rotary.h>               //Ben Buxton https://github.com/brianlow/Rotary
#include <si5351.h>               //Etherkit https://github.com/etherkit/Si5351Arduino
#include <EasyButton.h>           //https://easybtn.earias.me/docs/introduction
#include <LiquidCrystal.h>
#include <LcdBarGraph.h>          //https://playground.arduino.cc/Code/LcdBarGraph/

#define fMax  7300000UL
#define fMin  7000000UL
#define ddsCal 359000
#define LCD_RS  5
#define LCD_E   6
#define LCD_D4  7
#define LCD_D5  8
#define LCD_D6  9
#define LCD_D7  10
#define encoderButtonPin 11

unsigned long vfo = 7050000UL;    //Enter your initial frequency at startup, ex: 7000000 = 7MHz, 10000000 = 10MHz
unsigned long bfo = 9996800UL;    //BFO frequency for 10Mhz filter Bw = 3.2Khz
unsigned long opsfreq = 0UL;      //Operating freq to be generated by Si5351
unsigned long offset = 3200UL;    //IF Offset
unsigned long freqold, fstep;
const byte smeterPin = A0;        //Define analog pin for smeter
byte stp;                         //Frequency step counter


Rotary r = Rotary(3, 2);          // Encoder defined for Interrupt Pin 2,3
LiquidCrystal lcd(LCD_RS, LCD_E, LCD_D4, LCD_D5, LCD_D6, LCD_D7); 
Si5351 si5351(0x60);              //Si5351 I2C Address 0x60
EasyButton encoderButton (encoderButtonPin, true); //Create encoderButton Object as input with internal pullup resistors
LcdBarGraph smeter(&lcd,9,3,1);   //Creating bargraph instance, format is (&lcd, lcdNumCols, start X, start Y)


ISR(PCINT2_vect) 
{
  char result = r.process();
  if (result == DIR_CW) set_frequency(1);
  else if (result == DIR_CCW) set_frequency(-1);
}

void set_frequency(short dir) 
{    
  if (dir == 1) vfo = vfo + fstep;
  if (vfo >= fMax) vfo = fMax;                            //Upper tuning limit
  if (dir == -1) vfo = vfo - fstep;
  if (vfo < fMin) vfo = fMin;                             //lower tuning limit
}

void setup() 
{
  Serial.begin(57600);
  encoderButton.begin();
  Wire.begin();
  r.begin(true);                                         //Enable the Arduino's internal weak pull-ups for the rotary's pins external pullup
  lcd.begin(16, 2);
  delay (20);
  lcd.clear();  
  si5351.init(SI5351_CRYSTAL_LOAD_8PF, 0,ddsCal);        //Initialize Si5351, with 25Mhz Xtal
  si5351.set_pll(SI5351_PLL_FIXED, SI5351_PLLA);
  si5351.drive_strength(SI5351_CLK0, SI5351_DRIVE_6MA);  //Output current 2MA, 4MA, 6MA or 8MA
  si5351.drive_strength(SI5351_CLK2, SI5351_DRIVE_6MA);  //Output current 2MA, 4MA, 6MA or 8MA
  si5351.output_enable(SI5351_CLK0, 1);                  //1 - Enable / 0 - Disable CLK
  si5351.output_enable(SI5351_CLK1, 0);
  si5351.output_enable(SI5351_CLK2, 1);
  si5351.update_status();
  cli();
  PCICR |= (1 << PCIE2);
  PCMSK2 |= (1 << PCINT18) | (1 << PCINT19);
  sei();                                                // Enable all interrupts
  display_banner();
  si5351.set_freq(bfo * 100,SI5351_CLK2);               //Set bfo
  stp = 4;
  setsteps();
  encoderButton.onPressed(setsteps);
  encoderButton.onPressedFor(2000,set_bfo);
  tunegen();
  display_freq();
  display_radix();
}

void loop() 
{
  encoderButton.read();
  if (freqold != vfo)
  {
    tunegen();
    freqold = vfo;
  }
  display_freq();
  display_radix();
  smeter.drawValue(analogRead(smeterPin),512);
  delay(100);
}


void setsteps()
{
    switch (stp) 
    {
      case 1:stp = 2;fstep = 1;break;
      case 2:stp = 3;fstep = 10;break;
      case 3:stp = 4;fstep = 100;break;
      case 4:stp = 5;fstep = 1000;break;
      case 5:stp = 1;fstep = 10000;break;
    }
}


void tunegen()
{                           
   opsfreq =  vfo + bfo;                                //High side LO injection, Side band inversion
   si5351.set_freq(opsfreq * 100,SI5351_CLK0);          //Update operating frequency   
}


void display_freq() 
{
  uint16_t f;
  lcd.setCursor(2, 0);
  f = vfo / 1000000;  
  if (f < 10)
    lcd.print('0');
    lcd.print(f);
    lcd.print('.');
  f = (vfo % 1000000) / 1000;
  if (f < 100)
    lcd.print('0');
  if (f < 10)
    lcd.print('0');
    lcd.print(f);
    lcd.print('.');
  f = vfo % 1000;
  if (f < 100)
    lcd.print('0');
  if (f < 10)
    lcd.print('0');
    lcd.print(f);
    lcd.print("Hz");
}


void display_radix() 
{
  lcd.setCursor (0,1);
  lcd.print("Sm:");
  lcd.setCursor(13, 1);
  if (stp == 2) lcd.print("001"); if (stp == 3) lcd.print("010"); if (stp == 4) lcd.print("100");
  if (stp == 5) lcd.print("01K"); if (stp == 1) lcd.print("10K");
}

void flush_input(void)
{
  while (Serial.available() > 0)
  Serial.read();
}

void set_bfo(void)
{
  lcd.clear();
  lcd.setCursor(3, 0);
  lcd.print("BFO  SETUP");  
  Serial.print(F("Current BFO frequency is (Hz):"));
  Serial.println(bfo);
  Serial.println(F("Press w for increment in steps of 100Hz"));
  Serial.println(F("Press o for decrement in steps of 100Hz"));
  Serial.println(F("Press s for increment in steps of 10Hz"));
  Serial.println(F("Press l for decrement in steps of 10Hz"));
  Serial.println(F("Press q once done and note the final BFO"));
  while (1)
  {
  if (Serial.available() > 0)
  {
  char c = Serial.read();
  switch (c)
    {
      case 'q':
        flush_input();
        Serial.println();
        Serial.print(F("Final BFO frequency is (Hz):"));
        Serial.println(bfo);
        Serial.println();
        si5351.set_freq(bfo * 100,SI5351_CLK2);               //BFO
        return;
      case 'w': bfo += 100; break;
      case 'o': bfo -= 100; break;
      case 's': bfo += 10; break;
      case 'l': bfo -= 10; break;
      default:
      continue;
    }
    si5351.set_freq(bfo * 100,SI5351_CLK2);                   //Set running BFO
    Serial.print(F("BFO running at(Hz):"));
    Serial.println(bfo);
  }
 
 }
}


void display_banner()
{
  lcd.setCursor (3,0);
  lcd.print("Easy Bitx");
  lcd.setCursor (3,1);
  lcd.print("40m  Band");
  delay (3000);
  lcd.clear();  
}
